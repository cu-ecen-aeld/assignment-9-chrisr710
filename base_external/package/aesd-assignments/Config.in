## base_external/package/aesd-assignments/Config.in
```kconfig
config BR2_PACKAGE_AESD_ASSIGNMENTS2
	bool "aesd-assignments"
	help
	  Includes aesdsocket in the kernel image.
	  Used to understand buildroot external trees and package builds.
```

## base_external/package/aesd-assignments2/Config.in
```kconfig
config BR2_PACKAGE_AESD_ASSIGNMENTS2
	bool "aesd-assignments2"
	help
	  Includes aesdsocket in the kernel image.
	  Used to understand buildroot external trees and package builds.
```

## base_external/package/aesd-chardev/Config.in
```kconfig
config BR2_PACKAGE_AESD_CHARDEV
	bool "aesd-chardev"
	help
	  Adds the aesd-chardev device.
	  Used to understand buildroot external trees and package builds.
```
